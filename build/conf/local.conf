## build/conf/local.conf
```bitbake
MACHINE ??= "raspberrypi0-wifi"
#MACHINE ??= "raspberrypi4-64"
#MACHINE ??= "raspberrypi0-2w-64"
DISTRO ?= "poky"
#EXTRA_IMAGE_FEATURES += "read-only-rootfs"
PATCHRESOLVE = "noop"
DISTRO_FEATURES:remove = " acl alsa argp bluetooth irda largefile pcmcia usbgadget usbhost xattr nfs zeroconf pci 3g nfc x11 wayland pulseaudio "
IMAGE_FSTYPES = "rpi-sdimg"
#DISTRO_FEATURES:append = " systemd"
#VIRTUAL-RUNTIME_init_manager = "systemd"
#DISTRO_FEATURES_BACKFILL_CONSIDERED = "sysvinit"
BOOTDD_VOLUME_ID = "boot"
SERIAL_CONSOLES = ""
SYSVINIT_ENABLED_GETTYS = ""
#ENABLE_UART = "1"
GPU_MEM = "128"
VC4DTBO = "vc4-kms-v3d"
VIDEO_CAMERA = "1"
#RASPBERRYPI_CAMERA_V2 = "1"
CMDLINE = "root=/dev/mmcblk0p2 rootfstype=ext3 rootwait consoleblank=0 ro quiet "
#KERNEL_MODULE_AUTOLOAD += " vc4 v3d "
EXTRA_IMAGECMD:ext3 = "-i 4096 -L fs"
RPI_EXTRA_CONFIG = "hdmi_safe=1"
LICENSE_FLAGS_ACCEPTED = "synaptics-killswitch commercial"

CONF_VERSION = "2"
```
